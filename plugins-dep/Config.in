## plugins-dep/Config.in
```kconfig
# Wrapper for compatibility with buildroot < 2016.11
config BR2_EXTERNAL_MOD_PLUGIN_BUILDER_PATH
    string
    option env="BR2_EXTERNAL_MOD_PLUGIN_BUILDER_PATH"

source "$BR2_EXTERNAL_MOD_PLUGIN_BUILDER_PATH/package/camomile/Config.in"
source "$BR2_EXTERNAL_MOD_PLUGIN_BUILDER_PATH/package/carla-backend/Config.in"
source "$BR2_EXTERNAL_MOD_PLUGIN_BUILDER_PATH/package/dpf/Config.in"
source "$BR2_EXTERNAL_MOD_PLUGIN_BUILDER_PATH/package/fluidsynth/Config.in"
source "$BR2_EXTERNAL_MOD_PLUGIN_BUILDER_PATH/package/jack2mod/Config.in"
source "$BR2_EXTERNAL_MOD_PLUGIN_BUILDER_PATH/package/juce6/Config.in"
source "$BR2_EXTERNAL_MOD_PLUGIN_BUILDER_PATH/package/kxstudio-lv2-extensions/Config.in"
source "$BR2_EXTERNAL_MOD_PLUGIN_BUILDER_PATH/package/libgig/Config.in"
source "$BR2_EXTERNAL_MOD_PLUGIN_BUILDER_PATH/package/libmodla/Config.in"
source "$BR2_EXTERNAL_MOD_PLUGIN_BUILDER_PATH/package/libpd/Config.in"
source "$BR2_EXTERNAL_MOD_PLUGIN_BUILDER_PATH/package/lilv/Config.in"
source "$BR2_EXTERNAL_MOD_PLUGIN_BUILDER_PATH/package/lv2/Config.in"
source "$BR2_EXTERNAL_MOD_PLUGIN_BUILDER_PATH/package/lvtk/Config.in"
source "$BR2_EXTERNAL_MOD_PLUGIN_BUILDER_PATH/package/lvtk-1/Config.in"
source "$BR2_EXTERNAL_MOD_PLUGIN_BUILDER_PATH/package/mod-lv2-extensions/Config.in"
source "$BR2_EXTERNAL_MOD_PLUGIN_BUILDER_PATH/package/mod-plugin-builder/Config.in"
source "$BR2_EXTERNAL_MOD_PLUGIN_BUILDER_PATH/package/opus-custom/Config.in"
source "$BR2_EXTERNAL_MOD_PLUGIN_BUILDER_PATH/package/p7zip-light/Config.in"
source "$BR2_EXTERNAL_MOD_PLUGIN_BUILDER_PATH/package/python-pillow/Config.in"
source "$BR2_EXTERNAL_MOD_PLUGIN_BUILDER_PATH/package/python-pystache/Config.in"
source "$BR2_EXTERNAL_MOD_PLUGIN_BUILDER_PATH/package/serd/Config.in"
source "$BR2_EXTERNAL_MOD_PLUGIN_BUILDER_PATH/package/sord/Config.in"
source "$BR2_EXTERNAL_MOD_PLUGIN_BUILDER_PATH/package/sratom/Config.in"
source "$BR2_EXTERNAL_MOD_PLUGIN_BUILDER_PATH/package/zita-convolver/Config.in"
source "$BR2_EXTERNAL_MOD_PLUGIN_BUILDER_PATH/package/zita-resampler/Config.in"
```

## plugins-dep/configs/raspberrypi4_armv8_defconfig
```kconfig
BR2_arm=y
BR2_cortex_a72=y
BR2_ARM_FPU_NEON_VFPV4=y
BR2_DL_DIR="$(DOWNLOAD_PATH)"
BR2_OPTIMIZE_3=y
BR2_TOOLCHAIN_EXTERNAL=y
BR2_TOOLCHAIN_EXTERNAL_CUSTOM=y
BR2_TOOLCHAIN_EXTERNAL_PATH="$(TOOLCHAIN_PATH)"
BR2_TOOLCHAIN_EXTERNAL_CUSTOM_PREFIX="armv8-rpi4-linux-gnueabihf"
BR2_TOOLCHAIN_EXTERNAL_GCC_10=y
BR2_TOOLCHAIN_EXTERNAL_HEADERS_5_14=y
BR2_TOOLCHAIN_EXTERNAL_CUSTOM_GLIBC=y
BR2_TOOLCHAIN_EXTERNAL_CXX=y
BR2_TARGET_OPTIMIZATION="-mcpu=cortex-a72 -mfloat-abi=hard -mfpu=neon-fp-armv8 -mtune=cortex-a72 -ffast-math -fno-finite-math-only -fomit-frame-pointer -ftree-vectorize -funroll-loops -funsafe-loop-optimizations -D__MOD_DEVICES__ -D_MOD_DEVICE_RASPBERRYPI4 -Wl,-O1 -Wl,--as-needed -Wl,--strip-all"
BR2_TARGET_LDFLAGS="-Wl,-O1 -Wl,--as-needed -Wl,--strip-all"
BR2_ROOTFS_SKELETON_CUSTOM=y
BR2_ROOTFS_SKELETON_CUSTOM_PATH="/tmp/skeleton"
BR2_INIT_NONE=y
BR2_ROOTFS_DEVICE_CREATION_STATIC=y
BR2_ROOTFS_DEVICE_TABLE=""
BR2_ROOTFS_STATIC_DEVICE_TABLE=""
# BR2_PACKAGE_BUSYBOX is not set
BR2_PACKAGE_QT5=y
BR2_PACKAGE_ALSA_LIB=y
BR2_PACKAGE_LIBLO=y
BR2_PACKAGE_LIBSAMPLERATE=y
BR2_PACKAGE_LIBSNDFILE=y
BR2_PACKAGE_LIBVORBIS=y
BR2_PACKAGE_LILV=y
BR2_PACKAGE_CAIRO=y
BR2_PACKAGE_CAIRO_PNG=y
BR2_PACKAGE_NE10=y
BR2_PACKAGE_LIBXML2=y
BR2_PACKAGE_MXML=y
BR2_PACKAGE_BOOST=y
BR2_PACKAGE_BOOST_CONTRACT=y
BR2_PACKAGE_BOOST_COROUTINE=y
BR2_PACKAGE_BOOST_EXCEPTION=y
BR2_PACKAGE_BOOST_FIBER=y
BR2_PACKAGE_BOOST_GRAPH=y
BR2_PACKAGE_BOOST_GRAPH_PARALLEL=y
BR2_PACKAGE_BOOST_IOSTREAMS=y
BR2_PACKAGE_BOOST_JSON=y
BR2_PACKAGE_BOOST_LOCALE=y
BR2_PACKAGE_BOOST_MATH=y
BR2_PACKAGE_BOOST_MPI=y
BR2_PACKAGE_BOOST_NOWIDE=y
BR2_PACKAGE_BOOST_PROGRAM_OPTIONS=y
BR2_PACKAGE_BOOST_RANDOM=y
BR2_PACKAGE_BOOST_SERIALIZATION=y
BR2_PACKAGE_BOOST_STACKTRACE=y
BR2_PACKAGE_BOOST_TEST=y
BR2_PACKAGE_BOOST_TYPE_ERASURE=y
BR2_PACKAGE_BOOST_WAVE=y
BR2_PACKAGE_EIGEN=y
BR2_PACKAGE_FFTW=y
BR2_PACKAGE_FFTW_SINGLE=y
BR2_PACKAGE_FFTW_DOUBLE=y
BR2_PACKAGE_FFTW_FAST=y
BR2_PACKAGE_GLIBMM=y
BR2_PACKAGE_ICU=y
BR2_PACKAGE_ACL=y
# BR2_TARGET_ROOTFS_TAR is not set
BR2_PACKAGE_DPF=y
BR2_PACKAGE_FLUIDSYNTH=y
BR2_PACKAGE_JUCE6=y
BR2_PACKAGE_KXSTUDIO_LV2_EXTENSIONS=y
BR2_PACKAGE_LIBGIG=y
BR2_PACKAGE_LIBPD=y
BR2_PACKAGE_LVTK=y
BR2_PACKAGE_LVTK_1=y
BR2_PACKAGE_MOD_LV2_EXTENSIONS=y
BR2_PACKAGE_MOD_PLUGIN_BUILDER=y
BR2_PACKAGE_ZITA_CONVOLVER=y
BR2_PACKAGE_ZITA_RESAMPLER=y
```
